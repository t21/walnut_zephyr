## boards/arm/walnut/Kconfig.board
```kconfig
# Kconfig - nRF51 PCA10028 board configuration
#
# Copyright (c) 2016 Linaro Limited.
#
# SPDX-License-Identifier: Apache-2.0

config BOARD_WALNUT
	bool "Walnut"
	depends on SOC_NRF51822_QFAA
```

## boards/arm/walnut/Kconfig.defconfig
```kconfig
# Kconfig - nRF51 PCA10028 board configuration
#
# Copyright (c) 2016 Linaro Limited.
#
# SPDX-License-Identifier: Apache-2.0

if BOARD_WALNUT

config BOARD
	default "walnut"

config HAS_SEGGER_RTT
	default y

if GPIO_NRF5

config GPIO_NRF5_P0
	default y

endif # GPIO_NRF5

if UART_NRF5

config UART_NRF5_GPIO_TX_PIN
	default 9

config UART_NRF5_GPIO_RX_PIN
	default 11

config UART_NRF5_GPIO_RTS_PIN
	default 8

config UART_NRF5_GPIO_CTS_PIN
	default 10

endif # UART_NRF5

if I2C

config I2C_NRF5
	def_bool y

config I2C_0
	default y

endif # I2C

if I2C_NRF5

config I2C_NRF5_0_GPIO_SCL_PIN
	default 15

config I2C_NRF5_0_GPIO_SDA_PIN
	default 13

endif # I2C_NRF5

source ../walnut_zephyr/drivers/i2c_wrap/Kconfig
source ../walnut_zephyr/drivers/si7020/Kconfig
source ../walnut_zephyr/drivers/tsl4531/Kconfig
source ../walnut_zephyr/drivers/bmp280/Kconfig

endif # BOARD_WALNUT
```

## boards/arm/walnut/walnut_defconfig
```kconfig
CONFIG_ARM=y
CONFIG_SOC_FAMILY_NRF=y
CONFIG_SOC_SERIES_NRF51X=y
CONFIG_SOC_NRF51822_QFAA=y
CONFIG_BOARD_WALNUT=y

CONFIG_MAIN_STACK_SIZE=1152

# enable uart driver
#CONFIG_SERIAL=y
#CONFIG_UART_NRF5=y

# enable console
CONFIG_CONSOLE=y
CONFIG_RTT_CONSOLE=y

# bluetooth
CONFIG_BT=y
CONFIG_BT_CTLR=y

# logging
CONFIG_SYS_LOG=y
CONFIG_SYS_LOG_SHOW_TAGS=y
#CONFIG_SYS_LOG_SHOW_COLOR=y
CONFIG_SYS_LOG_DEFAULT_LEVEL=4
#CONFIG_SYS_LOG_OVERRIDE_LEVEL=0
#CONFIG_SYS_LOG_EXT_HOOK=y
```

## drivers/bmp280/Kconfig
```kconfig
# Kconfig.bmp280 - BMP280 temperature and pressure sensor configuration options

#
# Copyright (c) 2016 Intel Corporation
# Copyright (c) 2017 IpTronix S.r.l.
#
# SPDX-License-Identifier: Apache-2.0
#
menuconfig BMP280
	bool "BMP280 sensor"
	depends on I2C || SPI
	default	n
	help
	 Enable driver for BMP280 I2C-based or SPI-based temperature and pressure sensor.

config BMP280_DEV_NAME
	string "BMP280 device name"
	depends on BMP280
	default "BMP280"

choice
	prompt "BMP280 device select"
	depends on BMP280
	default BMP280_DEV_TYPE_I2C
	help
	  Select interface to communicate with BMP280 sensor. This sensor can communicate
	  with both SPI and I2C. I2C is the default, select SPI if you sensor is connected
	  via the SPI interface.

config BMP280_DEV_TYPE_SPI
	depends on SPI
	bool "SPI"
config BMP280_DEV_TYPE_I2C
	depends on I2C
	bool "I2C"
endchoice

config BMP280_I2C_ADDR
	hex "BMP280 I2C slave address"
	default 0x76
	depends on BMP280 && BMP280_DEV_TYPE_I2C
	help
	  Specify the I2C slave address for the BMP280.

	  0x76: Ground
	  0x77: VCC

config BMP280_I2C_MASTER_DEV_NAME
	string "I2C master where BMP280 is connected"
	depends on BMP280 && BMP280_DEV_TYPE_I2C
	default "I2C_0"
	help
	 Specify the device name of the I2C master device to which BMP280 is
	 connected.

config BMP280_SPI_DEV_NAME
	string "SPI device where BMP280 is connected"
	depends on BMP280 && BMP280_DEV_TYPE_SPI
	default "SPI_0"
	help
	 Specify the device name of the SPI device to which BMP280 is
	 connected.

config BMP280_SPI_DEV_SLAVE
	int "SPI Slave Select where BMP280 is connected"
	depends on BMP280 && BMP280_DEV_TYPE_SPI
	default 3
	help
	 Specify the Slave Select pin of the SPI device to which BMP280 CS is
	 connected.

menu "Attributes"
	depends on BMP280

choice
	prompt "BMP280 temperature oversampling"
	depends on BMP280
	default BMP280_TEMP_OVER_2X
	help
	  Select temperature oversampling for the BMP280 sensor.  Higher values
	  lead to more accurate readings, but higher power consumption.
config BMP280_TEMP_OVER_1X
	bool "x1"
config BMP280_TEMP_OVER_2X
	bool "x2"
config BMP280_TEMP_OVER_4X
	bool "x4"
config BMP280_TEMP_OVER_8X
	bool "x8"
config BMP280_TEMP_OVER_16X
	bool "x16"
endchoice

choice
	prompt "BMP280 pressure oversampling"
	depends on BMP280
	default BMP280_PRESS_OVER_16X
	help
	  Select pressure oversampling for the BMP280 sensor.  Higher values
	  lead to more accurate readings, but higher power consumption.
config BMP280_PRESS_OVER_1X
	bool "x1"
config BMP280_PRESS_OVER_2X
	bool "x2"
config BMP280_PRESS_OVER_4X
	bool "x4"
config BMP280_PRESS_OVER_8X
	bool "x8"
config BMP280_PRESS_OVER_16X
	bool "x16"
endchoice

choice
	prompt "BMP280 standby time"
	depends on BMP280
	default BMP280_STANDBY_1000MS
	help
	  Select standby time between measurements for the BMP280 sensor.
	  Higher values lead to lower power consumption.
config BMP280_STANDBY_05MS
	bool "0.5ms"
config BMP280_STANDBY_62MS
	bool "62.5ms"
config BMP280_STANDBY_125MS
	bool "125ms"
config BMP280_STANDBY_250MS
	bool "250ms"
config BMP280_STANDBY_500MS
	bool "500ms"
config BMP280_STANDBY_1000MS
	bool "1000ms"
config BMP280_STANDBY_2000MS
	bool "2000ms BMP280"
config BMP280_STANDBY_4000MS
	bool "4000ms BMP280"
endchoice

choice
	prompt "BMP280 filter coefficient"
	depends on BMP280
	default BMP280_FILTER_4
	help
	  Select the filter coefficient for the BMP280 sensor.
config BMP280_FILTER_OFF
	bool "filter off"
config BMP280_FILTER_2
	bool "2"
config BMP280_FILTER_4
	bool "4"
config BMP280_FILTER_8
	bool "8"
config BMP280_FILTER_16
	bool "16"
endchoice

endmenu
```

## drivers/i2c_wrap/Kconfig
```kconfig
#
# Copyright (c) 2016 Intel Corporation
#
# SPDX-License-Identifier: Apache-2.0
#

menuconfig I2C_WRAP
	bool
	prompt "Ambient Light Sensor Power via GPIO"
	default n
	depends on GPIO
	depends on I2C
	help
	  Enable driver for the Si7020 temperature sensor.

if I2C_WRAP
config I2C_WRAP_NAME
	string
	prompt "Driver name"
	default "i2c_wrap"
	help
	  Device name with which the Si7020 sensor is identified.

config AL_SENS_POW_GPIO_DEV_NAME
	string
	prompt "GPIO port"
	default "GPIO_0"
	help
	  The device name of the I2C master device to which the Si7020
	  chip is connected.

endif
```

## drivers/si7020/Kconfig
```kconfig
#
# Copyright (c) 2016 Intel Corporation
#
# SPDX-License-Identifier: Apache-2.0
#

menuconfig SI7020
	bool
	prompt "Si7020 Temperature Sensor"
	default n
	depends on I2C
	help
	  Enable driver for the Si7020 temperature sensor.

if SI7020
config SI7020_NAME
	string
	prompt "Driver name"
	default "Si7020"
	help
	  Device name with which the Si7020 sensor is identified.

config SI7020_I2C_MASTER_DEV_NAME
	string
	prompt "I2C Master"
	default "I2C_0"
	help
	  The device name of the I2C master device to which the Si7020
	  chip is connected.

endif
```

## drivers/tsl4531/Kconfig
```kconfig
#
# Copyright (c) 2016 Intel Corporation
#
# SPDX-License-Identifier: Apache-2.0
#

menuconfig TSL4531
	bool
	prompt "TSL4531 Ambient Light Sensor"
	default n
	depends on I2C
	help
	  Enable driver for the TSL4531 ambient light sensor.

if TSL4531
config TSL4531_NAME
	string
	prompt "Driver name"
	default "TSL4531"
	help
	  Device name with which the TSL4531 sensor is identified.

config TSL4531_I2C_MASTER_DEV_NAME
	string
	prompt "I2C Master"
	default "I2C_0"
	help
	  The device name of the I2C master device to which the TSL4531
	  chip is connected.

endif
```
